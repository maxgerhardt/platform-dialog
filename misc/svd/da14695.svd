# DA1469x register map
Vendor: Dialog; Series: DA1469x; File version: 1.2
690
CPU: CM33 r1p0, little endian, no MPU, FPU, 3 interrupt priority bits
Registers are 32-bit, read-write, reset 0x0 unless marked. A register's access mark holds for its fields unless they carry their own. Offsets are from the block's base; lines under a group give offsets from that group; [hi:lo] are bit positions; {n}, {i} and the like mark numbered series; 'fields as' and 'values as' point back to an identical list; <NAME> marks a mode.

## Memory map
0x100C0000 CACHE size 0x54 — CACHE registers
0x30020000 DW size 0x94 — DW registers
0x30030000 LCDC size 0x18C — LCDC registers
0x30040000 AES_HASH size 0x104 — AES_HASH registers
0x30070000 OTPC size 0x18 — OTPC registers
0x34000000 QSPIC2 size 0x48 — QSPIC2 registers
0x38000000 QSPIC size 0xB4 — QSPIC registers
0x40000000 CMAC size 0x2110 — CMAC registers
0x50000000 CRG_TOP size 0xFC — CRG_TOP registers
0x50000100 WAKEUP size 0x5C — WAKEUP registers
0x50000200 PDC size 0x98 — PDC registers
0x50000300 DCDC size 0x3C — DCDC registers
0x50000400 RTC size 0x98 — RTC registers
0x50000700 SYS_WDOG size 0x8 — SYS_WDOG registers
0x50010000 CRG_XTAL size 0x74 — CRG_XTAL registers
0x50010200 TIMER size 0x4C — TIMER registers
0x50010300 TIMER2 size 0x38 — TIMER2 registers
0x50010400 CMAC_TIMER_SLP size 0xC — CMAC_TIMER_SLP registers
0x50020000 UART size 0x100 — UART registers
0x50020100 UART2 size 0x100 — UART2 registers
0x50020200 UART3 size 0x100 — UART3 registers
0x50020300 SPI size 0xC — SPI registers
0x50020400 SPI2 size 0xC — SPI2 registers
0x50020600 I2C size 0x100 — I2C registers
0x50020700 I2C2 size 0x100 — I2C2 registers
0x50020800 SDADC size 0x1C — SDADC registers
0x50020900 CRG_COM size 0x10 — CRG_COM registers
0x50020A00 GPIO size 0x104 — GPIO registers
0x50020C00 SNC size 0x20 — SNC registers
0x50030500 PWMLED size 0x10 — PWMLED registers
0x50030600 APU size 0x114 — APU registers
0x50030900 GPADC size 0x1C — GPADC registers
0x50030A00 LRA size 0x5C — LRA registers
0x50030B00 ANAMISC size 0x1C — ANAMISC registers
0x50030C00 CRG_PER size 0x50 — CRG_PER registers
0x50030E00 SMOTOR size 0x84 — SMOTOR registers
0x50040000 USB size 0x1B0 — USB registers
0x50040200 CHIP_VERSION size 0x100 — CHIP_VERSION registers
0x50040300 GPREG size 0x1C — GPREG registers
0x50040400 CHARGER size 0x70 — CHARGER registers
0x50040500 CRG_SYS size 0x8 — CRG_SYS registers
0x50040600 RFMON size 0x18 — RFMON registers
0x50040800 DMA size 0x110 — DMA registers
0x50040A00 TIMER3 size 0x38 — TIMER3 registers
0x50040B00 TIMER4 size 0x38 — TIMER4 registers
0x50050000 MEMCTRL size 0x80 — MEMCTRL registers
0xE000EDD0 SAU size 0x20 — Security Attribution Unit

## Interrupts
0 SNC (AES_HASH) — Sensor Node Controller interrupt request.
1 DMA (AES_HASH) — General Purpose DMA interrupt request.
2 CHARGER_STATE (AES_HASH) — Charger State interrupt request.
3 CHARGER_ERROR (AES_HASH) — Charger Error interrupt request.
4 CMAC2SYS (AES_HASH) — CMAC and mailbox interrupt request.
5 UART (AES_HASH) — UART interrupt request.
6 UART2 (AES_HASH) — UART2 interrupt request.
7 UART3 (AES_HASH) — UART3 interrupt request.
8 I2C (AES_HASH) — I2C interrupt request.
9 I2C2 (AES_HASH) — I2C2 interrupt request.
10 SPI (AES_HASH) — SPI interrupt request.
11 SPI2 (AES_HASH) — SPI2 interrupt request.
12 PCM (AES_HASH) — PCM interrupt request.
13 SRC_IN (AES_HASH) — SRC input interrupt request.
14 SRC_OUT (AES_HASH) — SRC output interrupt request.
15 USB (AES_HASH) — USB interrupt request.
16 TIMER (AES_HASH) — TIMER interrupt request.
17 TIMER2 (AES_HASH) — TIMER2 interrupt request.
18 RTC (AES_HASH) — RTC interrupt request.
19 KEY_WKUP_GPIO (AES_HASH) — Debounced button press interrupt request.
20 PDC (AES_HASH) — Wakeup IRQ from PDC to CM33
21 VBUS (AES_HASH) — VBUS presence interrupt request.
22 MRM (AES_HASH) — Cache Miss Rate Monitor interrupt request.
23 MOTOR_CONTROLLER (AES_HASH) — MOTOR and mailbox interrupt request.
24 TRNG (AES_HASH) — True Random Number Generation interrupt request.
25 DCDC (AES_HASH) — DCDC interrupt request.
26 XTAL32M_RDY (AES_HASH) — XTAL32M trimmed and ready interrupt request.
27 GPADC (AES_HASH) — General Purpose Analog-Digital Converter interrupt request.
28 SDADC (AES_HASH) — Sigma Delta Analog-Digital Converter interrupt request.
29 CRYPTO (AES_HASH) — Crypto interrupt request.
30 CAPTIMER (AES_HASH) — GPIO triggered Timer Capture interrupt request.
31 RFDIAG (AES_HASH) — Baseband or Radio Diagnostics interrupt request.
32 LCD_CONTROLLER (AES_HASH) — Parallel LCD Controller interrupt request.
33 PLL_LOCK (AES_HASH) — Pll lock interrupt request.
34 TIMER3 (AES_HASH) — TIMER3 interrupt request.
35 TIMER4 (AES_HASH) — TIMER4 interrupt request.
36 LRA (AES_HASH) — LRA/ERM interrupt request.
37 RTC_EVENT (AES_HASH) — RTC event interrupt request.
38 GPIO_P0 (AES_HASH) — GPIO port 0 toggle interrupt request.
39 GPIO_P1 (AES_HASH) — GPIO port 1 toggle interrupt request.

## Licence text in the file
Copyright (C) 2019 Dialog Semiconductor. This computer program includes Confidential, Proprietary Information of Dialog Semiconductor. All Rights Reserved.
